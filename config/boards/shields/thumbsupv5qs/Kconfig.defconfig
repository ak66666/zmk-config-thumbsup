## config/boards/shields/thumbsupv5qs/Kconfig.defconfig
```kconfig
if SHIELD_THUMBSUPV5qs

config ZMK_KEYBOARD_NAME
    default "ThumbsUpV5qs"

config ZMK_POINTING
    default y
 
config I2C
    default y

endif
```

## config/boards/shields/thumbsupv9qs/Kconfig.defconfig
```kconfig
if SHIELD_THUMBSUPV9qs

config ZMK_KEYBOARD_NAME
    default "ThumbsUpV9qs"

config ZMK_POINTING
    default y
 
config I2C
    default y

endif
```
